/dts-v1/;
/plugin/;

#include <dt-bindings/clock/qcom,rpmh.h>

#include "pineapple-kiwi-cnss.dtsi"

/ {
	model = "Qualcomm Technologies, Inc. Pineapple SoCs";
	compatible = "qcom,pineapple", "qcom,pineapplep";
	qcom,msm-id = <557 0x10000>, <577 0x10000>, <557 0x20000>, <577 0x20000>,
			<682 0x10000>, <682 0x20000>, <696 0x10000>, <696 0x20000>,
			<645 0x10000>, <645 0x20000>, <646 0x10000>, <646 0x20000>,
			<702 0x10000>, <702 0x20000>;
	qcom,board-id = <1 0>, <8 0>, <11 0>, <0x15 0>, <0x1000B 0>, <0x10021 0>, <0x50001 0>, <0x50008 0>, <0x5000B 0>;
};

/* Xiaomi zorn: kiwi is clocked from RF_CLK1 */
&wlan_kiwi {
	clocks = <&rpmhcc RPMH_RF_CLK1>;
	clock-names = "rf_clk";
};
